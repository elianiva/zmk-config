## config/west.yml
```yaml
manifest:
  remotes:
    - name: urob
      url-base: https://github.com/petejohanson
  projects:
    - name: zmk
      remote: urob
      revision: main
      import: app/west.yml
  self:
    path: config
```
