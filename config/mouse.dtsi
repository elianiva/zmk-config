#define ZMK_MOUSE_DEFAULT_MOVE_VAL 1500  // 600
#define ZMK_MOUSE_DEFAULT_SCRL_VAL 20    // 10

#include <dt-bindings/zmk/pointing.h>

&mmv {
  acceleration-exponent = <1>;      // 1
  time-to-max-speed-ms = <500>;    // 40
};

&msc {
  acceleration-exponent = <1>;      // 0
  time-to-max-speed-ms = <40>;      // 500
};
